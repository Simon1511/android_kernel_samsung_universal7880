## arch/arm64/configs/oneui_defconfig
```kconfig
# CONFIG_USELIB is not set
CONFIG_CFS_BANDWIDTH=y
# CONFIG_MODULE_FORCE_LOAD is not set
CONFIG_OLAF_SUPPORT=y
CONFIG_Q_NFC=y
CONFIG_GRIPPOWER_VENDOR=y
CONFIG_HALL_EVENT_REVERSE=y
CONFIG_SOFT_WATCHDOG=y
# CONFIG_MALI_PLATFORM_THIRDPARTY is not set
# CONFIG_MALI_PLATFORM_THIRDPARTY_NAME is not set
CONFIG_USB_ANDROID_SAMSUNG_MTP=y
# CONFIG_EXFAT_FS is not set
# CONFIG_EXFAT_VIRTUAL_XATTR is not set
# CONFIG_EXFAT_VIRTUAL_XATTR_SELINUX_LABEL is not set
# CONFIG_EXFAT_SUPPORT_STLOG is not set
# CONFIG_LOCKUP_DETECTOR is not set
CONFIG_SECURITY_PERF_EVENTS_RESTRICT=y
# CONFIG_FORCE_PERMISSIVE is not set
# CONFIG_MST_LDO is not set
# CONFIG_INTEGRITY is not set
```

## arch/arm64/configs/treble_defconfig
```kconfig
# CONFIG_USELIB is not set
# CONFIG_CFS_BANDWIDTH is not set
CONFIG_MODULE_FORCE_LOAD=y
# CONFIG_OLAF_SUPPORT is not set
# CONFIG_Q_NFC is not set
CONFIG_GRIPPOWER_VENDOR=y
# CONFIG_HALL_EVENT_REVERSE is not set
# CONFIG_SOFT_WATCHDOG is not set
CONFIG_MALI_PLATFORM_THIRDPARTY=y
CONFIG_MALI_PLATFORM_THIRDPARTY_NAME="exynos"
CONFIG_FB_NOTIFIER=y
# CONFIG_USB_ANDROID_SAMSUNG_MTP is not set
CONFIG_EXFAT_FS=y
CONFIG_EXFAT_VIRTUAL_XATTR=y
CONFIG_EXFAT_VIRTUAL_XATTR_SELINUX_LABEL="u:object_r:sdcard_external:s0"
CONFIG_EXFAT_SUPPORT_STLOG=y
CONFIG_LOCKUP_DETECTOR=y
CONFIG_HARDLOCKUP_DETECTOR_OTHER_CPU=y
CONFIG_HARDLOCKUP_DETECTOR=y
CONFIG_BOOTPARAM_HARDLOCKUP_PANIC=y
CONFIG_BOOTPARAM_HARDLOCKUP_PANIC_VALUE=1
CONFIG_BOOTPARAM_SOFTLOCKUP_PANIC=y
CONFIG_BOOTPARAM_SOFTLOCKUP_PANIC_VALUE=1
CONFIG_DETECT_HUNG_TASK=y
CONFIG_DEFAULT_HUNG_TASK_TIMEOUT=120
# CONFIG_BOOTPARAM_HUNG_TASK_PANIC is not set
CONFIG_BOOTPARAM_HUNG_TASK_PANIC_VALUE=0
CONFIG_SECURITY_PERF_EVENTS_RESTRICT=y
CONFIG_FORCE_PERMISSIVE=y
CONFIG_MST_LDO=y
CONFIG_INTEGRITY=y
```

## drivers/of/Kconfig
```kconfig
config DTC
	bool

config OF
	bool

menu "Device Tree and Open Firmware support"
	depends on OF

config OF_SELFTEST
	bool "Device Tree Runtime self tests"
	depends on OF_IRQ && OF_EARLY_FLATTREE
	select OF_DYNAMIC
	select OF_RESOLVE
	help
	  This option builds in test cases for the device tree infrastructure
	  that are executed once at boot time, and the results dumped to the
	  console.

	  If unsure, say N here, but this option is safe to enable.

config OF_FLATTREE
	bool
	select DTC
	select LIBFDT

config OF_EARLY_FLATTREE
	bool
	select OF_FLATTREE

config OF_PROMTREE
	bool

# Hardly any platforms need this.  It is safe to select, but only do so if you
# need it.
config OF_DYNAMIC
	bool

config OF_ADDRESS
	def_bool y
	depends on !SPARC
	select OF_ADDRESS_PCI if PCI

config OF_ADDRESS_PCI
	bool

config OF_IRQ
	def_bool y
	depends on !SPARC

config OF_NET
	depends on NETDEVICES
	def_bool y

config OF_MDIO
	def_tristate PHYLIB
	depends on PHYLIB
	help
	  OpenFirmware MDIO bus (Ethernet PHY) accessors

config OF_PCI
	def_tristate PCI
	depends on PCI
	help
	  OpenFirmware PCI bus accessors

config OF_PCI_IRQ
	def_tristate PCI
	depends on OF_PCI && OF_IRQ
	help
	  OpenFirmware PCI IRQ routing helpers

config OF_MTD
	depends on MTD
	def_bool y

config OF_RESERVED_MEM
	depends on OF_EARLY_FLATTREE
	bool
	help
	  Helpers to allow for reservation of memory regions

config OF_RESOLVE
	bool

endmenu # OF

menuconfig EXYNOS_DTBTOOL
	bool "Build dtbtool for Exynos"
	select DTC
	default n
	help
	  Say Y here to build the dtbtool for Exynos,
	  which is necessary to create DTB images for
	  use in Exynos boot images.

if EXYNOS_DTBTOOL

config EXYNOS_DTBH_PLATFORM_CODE
	hex "Exynos DTBH hex platform code"
	default 0x50a6
	help
	  This value is verified by the bootloader
	  to determine if the DTB image is valid for
	  the device that the kernel is booting on.

config EXYNOS_DTBH_SUBTYPE_CODE
	hex "Exynos DTBH hex subtype code"
	default 0x217584da
	help
	  This value is verified by the bootloader
	  to determine if the DTB image is valid for
	  the device that the kernel is booting on.

config EXYNOS_DTBH_PAGE_SIZE
	int "Exynos DTBH page size"
	range 2048 131072
	default 2048
	help
	  Page size used to pad the DTB image.
	  It should be equal to the page size of
	  the Exynos boot image.
	  Must be divisible by 2048.

endif
```
